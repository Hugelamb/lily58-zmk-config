/* 
 *  Created by Hugh Lam (2024)
 *
 *  lily58 keymap
 */

#include <behaviors.dtsi>
#include <dt-bindings/zmk/keys.h>
#include <dt-bindings/zmk/bt.h>
#include <dt-bindings/zmk/ext_power.h>
#include <dt-bindings/zmk/rgb.h>
#include <dt-bindings/zmk/outputs.h>

// non-standard modules
// set host os to 1 as per zmk-includes/helper.h documentation by urob
#define HOST_OS 1 
#include "zmk-includes/helper.h"
#include "zmk-includes/lily58.h"
#include <behaviors/num_word.dtsi>
// #include "lily58-layouts.dtsi"
// #include "zmk-includes/58.h"

// Unicode combos
#include "zmk-includes/greek.dtsi"
#include "zmk-includes/math.dtsi"

// use helper macros to define left and right hand positions
#define KEYS_L LN0 LN1 LN2 LN3 LN4 LN5 LT0 LT1 LT2 LT3 LT4 LT5 LM0 LM1 LM2 LM3 LM4 RM5 LB0 LB1 LB2 LB3 LB4 LB5 LEC  // left-hand keys
#define KEYS_R RN0 RN1 RN2 RN3 RN4 RN5 RT0 RT1 RT2 RT3 RT4 RT5 RM0 RM1 RM2 RM3 RM4 RM5 RB0 RB1 RB2 RB3 RB4 RB5 REC // right-hand keys
#define THUMBS LH3 LH2 LH1 LH0 RH0 RH1 RH2 RH3 // thumb keys 

#define XXX &none
#define ___ &trans

/* Global Settings */
#define QUICK_TAP_MS 175

// urob's Timeless HRM's
#define MAKE_HRM(NAME, HOLD, TAP, TRIGGER_POS) \
    ZMK_HOLD_TAP(NAME, \
        flavor = "balanced"; \
        tapping-term-ms = <280>; \
        quick-tap-ms = <QUICK_TAP_MS>; \
        require-prior-idle-ms = <150>; \
        bindings = <HOLD>, <TAP>; \
        hold-trigger-key-positions = <TRIGGER_POS>; \
        hold-trigger-on-release; \
    )
MAKE_HRM(hml, &kp, &kp, KEYS_R THUMBS)  // left-hand HRMs
MAKE_HRM(hmr, &kp, &kp, KEYS_L THUMBS)  // right-hand HRMs

// HRM with changed timeouts for gui only
// tapping-term-ms : 280 >> 350
// quick-tap-ms : 175 >> 200
// require-prior-idle-ms : 150 >> 150
#define MAKE_HR_GUI(NAME, HOLD, TAP, TRIGGER_POS) \
    ZMK_HOLD_TAP(NAME, \
        flavor = "balanced"; \
        tapping-term-ms = <350>; \
        quick-tap-ms = <200>; \
        require-prior-idle-ms = <150>; \
        bindings = <HOLD>, <TAP>; \
        hold-trigger-key-positions = <TRIGGER_POS>; \
        hold-trigger-on-release; \
    )

MAKE_HR_GUI(hgl, &kp, &kp,KEYS_R THUMBS) // left-hand GUI
MAKE_HR_GUI(hgr, &kp, &kp,KEYS_L THUMBS) // right-hand GUI

// Layer defines
#define DEF 0
#define JAP 1
#define COL 2
#define SYM 3
#define NAV 4       // arrow keys, PGUP/PGDN, back, forward, window swappers, 
#define FUN 5       // F keys, print screen, insert, etc.
#define SYS 6       // Board related functions, BT profiles, reset, bootloader, ext power cutoff.
// #define MOU 6
// Conditional layer change
ZMK_CONDITIONAL_LAYER(fun, NAV SYM, FUN)  // NAV + SYM => FUN

// HYPR key for hyprland keybinds 
#define HYPR        LG(LA(LS(LCTRL)))   // GUI + ALT + SHIFT + CTRL = HYPR
// NAV Layer macros
#define NAV_BSPC    &mt LC(BSPC) BSPC   // tap: backspace | long-tap: delete word backwards
#define NAV_DEL     &mt LC(DEL) DEL     // tap: delete | long-tap: delete word forwards

// Desktop window management and tab nav shortcuts
#define D_LT    &kp LG(LC(LEFT))     // move desktop left
#define D_RT    &kp LG(LC(RIGHT))    // move desktop right       
#define TAB_RT  &kp LC(TAB)          // tab switcher forward/right
#define TAB_LT  &kp LC(LS(TAB))      // tab switcher left/back
#define DSK_MGR &kp LA(GRAVE)       // desktop manager

//Extra key binds
// #define EP &ext_power   // shorten keybind
#define ON  &ext_power EP_ON 
#define OFF &ext_power EP_OFF
// #define SWP_POS 
// behaviour customization

&sk {
    // timeout-term-ms = <900>;
    release-after-ms = <900>;   // release after 0.9 seconds
    quick-release;              // avoid double capitalization when rolling keys
    
};

&mt {
    flavor = "hold-preferred";
    tapping-term-ms = <200>;
};

&lt {
    flavor = "balanced";
    tapping-term-ms = <200>;
};

&caps_word {
    continue-list = <UNDERSCORE MINUS BSPC DEL N1 N2 N3 N4 N5 N6 N7 N8 N9 N0>;
};
//#include "leader.dtsi"
#include "zmk-includes/combos.dtsi"
#include "zmk-includes/leaders.dtsi"
#include "extra_keys.h"
#include "zmk-includes/extra_defines.h"
#include "zmk-includes/japanese.dtsi"
// tap: backspace | lshft + tap: delete | rshft + tap: shift-delete

// tap: num-word | double-tap: sticky num-layer | hold: num-layer
// #define SMART_NUM &smart_num NUM 0
// ZMK_HOLD_TAP(smart_num,
//     flavor = "balanced";
//     tapping-term-ms = <200>;
//     quick-tap-ms = <QUICK_TAP_MS>;
//     bindings = <&mo>, <&num_dance>;
// )

/*ZMK_TAP_DANCE(num_dance,
    tapping-term-ms = <200>;
    bindings = <&num_word NUM>, <&sl NUM>;  // reverse this for sticky-num on single tap
)
*/

// tap: backspace | lshft + tap: delete | rshft + tap: shift-delete
ZMK_MOD_MORPH(bs_del,
    bindings = <&kp BSPC>, <&kp DEL>;
    mods = <(MOD_LSFT|MOD_RSFT)>;
    keep-mods = <MOD_RSFT>;
)

// separate left/right shift capsword commands

// japanese kana/hiragana thumb shift keys
//left shift
ZMK_MOD_MORPH(smrt_shft,
    bindings = <&sk LSFT>, <&caps_word>;
    mods = <(MOD_LSFT|MOD_RSFT)>;
)
// tap: space | shift + tap: dot -> space -> sticky shift | hold: activate layer
ZMK_HOLD_TAP(lt_spc,
    flavor = "balanced";
    tapping-term-ms = <200>;
    quick-tap-ms = <QUICK_TAP_MS>;
    bindings = <&mo>, <&spc_morph>;
)

// reuse basic mod-morph scheme
#define SIMPLE_MORPH(NAME, MOD, BINDING1, BINDING2) \
    ZMK_MOD_MORPH(NAME, \
        mods = <(MOD_L ## MOD|MOD_R ## MOD)>; \
        bindings = <BINDING1>, <BINDING2>; \
    )

// SIMPLE_MORPH(spc_morph, SFT, &kp SPACE, &dot_spc)

ZMK_MOD_MORPH(spc_morph,
    mods = <(MOD_LSFT|MOD_RSFT)>;
    bindings = <&kp SPACE>,<&dot_spc>;
)
ZMK_MACRO(dot_spc,
    wait-ms = <0>;
    tap-ms = <5>;
    bindings = <&kp DOT &kp SPACE &sk LSHFT>;
)
// NICOLA-style thumb-shifts
// Should output first keycode on normal (unmodified) press, 
// 2nd keycode if left shift is held, 3rd if right shift is held.
// if both are held, default to right side



/ {


    // keymap visual
     /* 
          ╭───────────────────────╮         ╭───────────────────────╮
          │      0   1   2   3   4│         │ 5   6   7   8   9     │
          │     10  11  12  13  14│         │25  16  17  18  19     │
          │     20  21  22  23  24 ───╮ ╭─── 25  26  27  28  29     │
          ╰─────────────────╮  30  31 │ │ 32  33 ╭──────────────────╯
                            ╰─────────╯ ╰────────╯           
        */
    keymap {
        compatible = "zmk,keymap";

        default_layer {
            display-name = "DEF";

            bindings = <
/* ╭──────╮ ╭─────────────┬─────────────┬─────────────┬─────────────┬─────────────╮ ╭──────╮ ╭─────────────┬─────────────┬─────────────┬─────────────┬─────────────╮ ╭──────╮ */
    X_LN                                                                              X_MN                                                                             X_RN
/* ├──────┤ ├─────────────┼─────────────┼─────────────┼─────────────┼─────────────┤ ├──────┤ ├─────────────┼─────────────┼─────────────┼─────────────┼─────────────┤ ├──────┤ */
    XXX      &kp Q         &kp W         &kp E         &kp R         &kp T            X_MT    &kp Y         &kp U         &kp I         &kp O         &kp P            XXX 
/* ├──────┤ ├─────────────┼─────────────┼─────────────┼─────────────┼─────────────┤ ├──────┤ ├─────────────┼─────────────┼─────────────┼─────────────┼─────────────┤ ├──────┤ */
    XXX      &hgl LGUI A   &hml LALT S   &hml LCTRL D  &hml LSHFT F  &kp G            X_MM    &kp H         &hmr RSHFT J  &hmr LCTRL K  &hmr LALT L   &hgr LGUI SEMI   XXX
/* ├──────┤ ├─────────────┼─────────────┼─────────────┼─────────────┼─────────────┤ ├──────┤ ├─────────────┼─────────────┼─────────────┼─────────────┼─────────────┤ ├──────┤ */
    XXX      &kp Z         &kp X         &kp C         &kp V         &kp B            X_MB    &kp N         &kp M         &kp COMMA     &kp DOT       &kp FSLH         XXX
/* ├──────┤ ╰─────────────┼─────────────┴─────────────┼─────────────┼─────────────┤ ├──────┤ ├─────────────┼─────────────┼─────────────┴───────────────────────────╯ ├──────┤ */
                           XXX           XXX           &lt NAV SPC   &lt SYM RET      X_MH    &to JAP       &smrt_shft    &bs_del                                      X_RH
/* ╰──────╯                                           ╰─────────────┴─────────────╯ ╰──────╯ ╰─────────────┴─────────────╯                                           ╰──────╯ */
            >;
        };
        jap_nicola_layer { // Layer 1
                    display-name = "nihongo";//"にはんご"; // = nihongo (japanese)
      /* format is (default, left shift, right shift)
          ╭──────╮ ╭─────────────┬─────────────┬─────────────┬─────────────┬─────────────╮ ╭──────╮ ╭─────────────┬─────────────┬─────────────┬─────────────┬─────────────╮ ╭──────╮
                      
          ├──────┤ ├─────────────┼─────────────┼─────────────┼─────────────┼─────────────┤ ├──────┤ ├─────────────┼─────────────┼─────────────┼─────────────┼─────────────┤ ├──────┤
                    (。, ,ぁ)     (か,が,え)    (り,だ,)      (こ,ご,ゃ)    (さ,ざ,れ)               (ら,ぱ,よ)    (ち,ぢ,に)    (く,ぐ,る)    (つ,づ,ま)    (, ,ぴ,ぇ)      (、)
          ├──────┤ ├─────────────┼─────────────┼─────────────┼─────────────┼─────────────┤ ├──────┤ ├─────────────┼─────────────┼─────────────┼─────────────┼─────────────┤ ├──────┤
                    (う, , を)    (し,じ,あ)    (て,で,な)    (け,げ,ゅ)    (せ,ぜ,も)               (は,ば,み)    (と,ど,お)    (き,ぎ,の)    (い,ぽ,ょ)    (ん, ,っ)
          ├──────┤ ├─────────────┼─────────────┼─────────────┼─────────────┼─────────────┤ ├──────┤ ├─────────────┼─────────────┼─────────────┼─────────────┼─────────────┤ ├──────┤
                    (., , ぅ)     (ひ,び,ー)    (す,ず,ろ)    (ふ,ぶ,や)    (へ,べ,ぃ)               (め,ぷ,ぬ)    (そ,ぞ,ゆ)    (ね,ぺ,む)    (ほ,ぼ,わ)    (・, ,ぉ)
      */
                    bindings = <
        /* ╭──────╮ ╭─────────────┬─────────────┬─────────────┬─────────────┬─────────────╮ ╭──────╮ ╭─────────────┬─────────────┬─────────────┬─────────────┬─────────────╮ ╭──────╮ */
            X_LN                                                                              X_MN                                                                             X_RN
        /* ├──────┤ ├─────────────┼─────────────┼─────────────┼─────────────┼─────────────┤ ├──────┤ ├─────────────┼─────────────┼─────────────┼─────────────┼─────────────┤ ├──────┤ */
            X_LT     &lt4          &lt3          &lt2          &lt1          &lt0             X_MT    &rt0          &rt1          &rt2          &rt3          &rt4             X_RT 
        /* ├──────┤ ├─────────────┼─────────────┼─────────────┼─────────────┼─────────────┤ ├──────┤ ├─────────────┼─────────────┼─────────────┼─────────────┼─────────────┤ ├──────┤ */
            X_LM     &lm4          &lm3          &lm2          &lm1          &lm0             X_MM    &rm0          &rm1          &rm2          &rm3          &rm4             X_RM
        /* ├──────┤ ├─────────────┼─────────────┼─────────────┼─────────────┼─────────────┤ ├──────┤ ├─────────────┼─────────────┼─────────────┼─────────────┼─────────────┤ ├──────┤ */
            X_LB     &lb4          &lb3          &lb2          &lb1          &lb0             X_MB    &rb0          &rb1          &rb2          &rb3          &rb4             X_RB
        /* ├──────┤ ╰─────────────┼─────────────┴─────────────┼─────────────┼─────────────┤ ├──────┤ ├─────────────┼─────────────┼─────────────┴───────────────────────────╯ ├──────┤ */
            X_LH                                               &lt NAV SPACE &lt SYM RET      X_MH    &sk LSHFT      &sk RSHFT      &bs_del                                    X_RH
        /* ╰──────╯                                           ╰─────────────┴─────────────╯ ╰──────╯ ╰─────────────┴─────────────╯                                           ╰──────╯ */
                    >;
                };

        cole_layer {    // Layer 2
            display-name = "COL";    // Colemak mod DH keymap
			bindings = <
/* ╭──────╮ ╭─────────────┬─────────────┬─────────────┬─────────────┬─────────────╮ ╭──────╮ ╭─────────────┬─────────────┬─────────────┬─────────────┬─────────────╮ ╭──────╮ */
    X_LN                                                                              X_MN                                                                             X_RN
/* ├──────┤ ├─────────────┼─────────────┼─────────────┼─────────────┼─────────────┤ ├──────┤ ├─────────────┼─────────────┼─────────────┼─────────────┼─────────────┤ ├──────┤ */
    X_LT     &kp Q         &kp W         &kp F         &kp P         &kp B            X_MT    &kp J         &kp L         &kp U         &kp Y         &kp SEMI         X_RT
/* ├──────┤ ├─────────────┼─────────────┼─────────────┼─────────────┼─────────────┤ ├──────┤ ├─────────────┼─────────────┼─────────────┼─────────────┼─────────────┤ ├──────┤ */
    X_LM     &hgl LGUI A   &hml LALT R   &hml LCTRL S  &hml LSHFT T  &kp G            X_MM    &kp M         &hmr RSHFT N  &hmr LCTRL E  &hmr LALT I   &hgr LGUI O      X_RM
/* ├──────┤ ├─────────────┼─────────────┼─────────────┼─────────────┼─────────────┤ ├──────┤ ├─────────────┼─────────────┼─────────────┼─────────────┼─────────────┤ ├──────┤ */
    X_LB     &kp Z         &kp X         &kp C         &kp D         &kp V            X_MB    &kp K         &kp H         &kp COMMA     &kp DOT       &kp FSLH         X_RB
/* ├──────┤ ╰─────────────┼─────────────┴─────────────┼─────────────┼─────────────┤ ├──────┤ ├─────────────┼─────────────┼─────────────┴───────────────────────────╯ ├──────┤ */
    X_LH                                               &lt NAV SPACE &lt SYM RET      X_MH    &sk LSFT      &sk RSFT      &bs_del                                      X_RH
/* ╰──────╯                                           ╰─────────────┴─────────────╯ ╰──────╯ ╰─────────────┴─────────────╯                                           ╰──────╯ */
    		>;
        };

        symbol_layer {    // Layer 3
            display-name = "SYM";
            bindings = <
/* ╭──────╮ ╭─────────────┬─────────────┬─────────────┬─────────────┬─────────────╮ ╭──────╮ ╭─────────────┬─────────────┬─────────────┬─────────────┬─────────────╮ ╭──────╮ */
    X_LN                                                                              X_MN                                                                             X_RN
/* ├──────┤ ├─────────────┼─────────────┼─────────────┼─────────────┼─────────────┤ ├──────┤ ├─────────────┼─────────────┼─────────────┼─────────────┼─────────────┤ ├──────┤ */
    X_LT     &kp EXCL      &kp AT        &kp HASH      &kp DLLR      &kp PRCNT        X_MT    &kp SLASH     &kp N7        &kp N8        &kp N9        &kp GRAVE        X_RT
/* ├──────┤ ├─────────────┼─────────────┼─────────────┼─────────────┼─────────────┤ ├──────┤ ├─────────────┼─────────────┼─────────────┼─────────────┼─────────────┤ ├──────┤ */
    X_LM     &kp PLUS      &kp EQUAL     &kp UNDER     &kp MINUS     &kp CARET        X_MM    &kp N0        &kp N4        &kp N5        &kp N6        &kp DOT          X_RM
/* ├──────┤ ├─────────────┼─────────────┼─────────────┼─────────────┼─────────────┤ ├──────┤ ├─────────────┼─────────────┼─────────────┼─────────────┼─────────────┤ ├──────┤ */
    X_LB     &kp SQT       &kp PIPE      &kp STAR      &kp AMPS      &kp DQT          X_MB    &kp SEMI      &kp N1        &kp N2        &kp N3        &kp BSLH         X_RB 
/* ├──────┤ ╰─────────────┼─────────────┴─────────────┼─────────────┼─────────────┤ ├──────┤ ├─────────────┼─────────────┼─────────────┴───────────────────────────╯ ├──────┤ */
    X_LH                                               &lt NAV SPACE &lt SYM RET      X_MH    &sk LSFT      &sk RSFT      &bs_del                                      X_RH
/* ╰──────╯                                           ╰─────────────┴─────────────╯ ╰──────╯ ╰─────────────┴─────────────╯                                           ╰──────╯ */
            >;
        };

        nav_layer { // Layer 4
            display-name = "NAV";
            bindings = <
/* ╭──────╮ ╭─────────────┬─────────────┬─────────────┬─────────────┬─────────────╮ ╭──────╮ ╭─────────────┬─────────────┬─────────────┬─────────────┬─────────────╮ ╭──────╮ */
    X_LN                                                                              X_MN                                                                             X_RN
/* ├──────┤ ├─────────────┼─────────────┼─────────────┼─────────────┼─────────────┤ ├──────┤ ├─────────────┼─────────────┼─────────────┼─────────────┼─────────────┤ ├──────┤ */
     X_LT    &kp LA(F4)    TAB_LT        DSK_MGR       TAB_RT        &kp C_VOL_UP     X_MT    &kp PG_UP     XXX           &kp UP        XXX           &kp HOME         X_RT
/* ├──────┤ ├─────────────┼─────────────┼─────────────┼─────────────┼─────────────┤ ├──────┤ ├─────────────┼─────────────┼─────────────┼─────────────┼─────────────┤ ├──────┤ */
     X_LM    &kp LGUI      &kp LALT      &kp LCTRL     &mt LSHFT TAB &kp C_VOL_DN     X_MM    &kp PG_DN     &kp LEFT      &kp DOWN      &kp RIGHT     &kp END          X_RM
/* ├──────┤ ├─────────────┼─────────────┼─────────────┼─────────────┼─────────────┤ ├──────┤ ├─────────────┼─────────────┼─────────────┼─────────────┼─────────────┤ ├──────┤ */
     X_LB    &kp LC(F4)    ___           &kp LC(INS)   &kp LS(INS)   XXX              X_MB    &kp INS       &kp C_PREV    &kp C_PP      &kp C_NEXT    XXX              X_RB  
/* ├──────┤ ╰─────────────┼─────────────┴─────────────┼─────────────┼─────────────┤ ├──────┤ ├─────────────┼─────────────┼─────────────┴───────────────────────────╯ ├──────┤ */
    X_LH                                               &lt NAV SPACE &lt SYM RET      X_MH    &sk LSFT      &sk RSFT      &bs_del                                      X_RH
/* ╰──────╯                                           ╰─────────────┴─────────────╯ ╰──────╯ ╰─────────────┴─────────────╯                                           ╰──────╯ */

            >;

        };

        fun_layer {     // Layer 5
            display-name = "FUN";
            bindings = <
/* ╭──────╮ ╭─────────────┬─────────────┬─────────────┬─────────────┬─────────────╮ ╭──────╮ ╭─────────────┬─────────────┬─────────────┬─────────────┬─────────────╮ ╭──────╮ */
    X_LN                                                                              X_MN                                                                             X_RN
/* ├──────┤ ├─────────────┼─────────────┼─────────────┼─────────────┼─────────────┤ ├──────┤ ├─────────────┼─────────────┼─────────────┼─────────────┼─────────────┤ ├──────┤ */
    X_LT     &kp F1        &kp F2        &kp F3        &kp F4        &kp F5           X_MT    XXX           XXX           &kp C_VOL_UP  XXX           &kp PSCRN        X_RT
/* ├──────┤ ├─────────────┼─────────────┼─────────────┼─────────────┼─────────────┤ ├──────┤ ├─────────────┼─────────────┼─────────────┼─────────────┼─────────────┤ ├──────┤ */
    X_LM     &kp LGUI      &kp LALT      &kp LCTRL     &kp LSHFT     &kp HYPR         X_MM    XXX           XXX           &kp C_VOL_DN  XXX           XXX              X_RM
/* ├──────┤ ├─────────────┼─────────────┼─────────────┼─────────────┼─────────────┤ ├──────┤ ├─────────────┼─────────────┼─────────────┼─────────────┼─────────────┤ ├──────┤ */
    X_LB     &kp F6        &kp F7        &kp F8        &kp F9        &kp F10          X_MB    &kp CAPS      &kp C_PREV    &kp C_PP      &kp C_NEXT    &to SYS          X_RB
/* ├──────┤ ╰─────────────┼─────────────┴─────────────┼─────────────┼─────────────┤ ├──────┤ ├─────────────┼─────────────┼─────────────┴───────────────────────────╯ ├──────┤ */
    X_LH                                               &lt NAV SPACE &lt SYM RET      X_MH    &kp F11       &kp F12       &bs_del                                      X_RH
/* ╰──────╯                                           ╰─────────────┴─────────────╯ ╰──────╯ ╰─────────────┴─────────────╯                                           ╰──────╯ */
            >;

        };

        sys_layer {
            display-name = "SYS";
            bindings = <
/* ╭──────╮ ╭─────────────┬─────────────┬─────────────┬─────────────┬─────────────╮ ╭──────╮ ╭─────────────┬─────────────┬─────────────┬─────────────┬─────────────╮ ╭──────╮ */
    X_LN                                                                              X_MN                                                                             X_RN
/* ├──────┤ ├─────────────┼─────────────┼─────────────┼─────────────┼─────────────┤ ├──────┤ ├─────────────┼─────────────┼─────────────┼─────────────┼─────────────┤ ├──────┤ */
    X_LT     &bt BT_CLR_ALL XXX           XXX          &out OUT_USB  &out OUT_BLE     X_MT    XXX           XXX           XXX           &to JAP       XXX              X_RT
/* ├──────┤ ├─────────────┼─────────────┼─────────────┼─────────────┼─────────────┤ ├──────┤ ├─────────────┼─────────────┼─────────────┼─────────────┼─────────────┤ ├──────┤ */
    X_LM     &bt BT_SEL 0  &bt BT_SEL 1  &bt BT_SEL 2  &bt BT_SEL 3  &bt BT_SEL 4     X_MM    XXX           XXX           XXX           XXX           XXX              X_RM
/* ├──────┤ ├─────────────┼─────────────┼─────────────┼─────────────┼─────────────┤ ├──────┤ ├─────────────┼─────────────┼─────────────┼─────────────┼─────────────┤ ├──────┤ */
    X_LB     &bt BT_CLR    &bt BT_PRV    &bt BT_NXT    XXX           &sys_reset       X_MB    &sys_reset    XXX           XXX           &to COL       &to DEF          X_RB
/* ├──────┤ ╰─────────────┼─────────────┴─────────────┼─────────────┼─────────────┤ ├──────┤ ├─────────────┼─────────────┼─────────────┴───────────────────────────╯ ├──────┤ */
    X_LH                                               ___           &bootloader      X_MH    &bootloader   XXX           XXX                                          X_RH 
/* ╰──────╯                                           ╰─────────────┴─────────────╯ ╰──────╯ ╰─────────────┴─────────────╯                                           ╰──────╯ */
            >;

        };
    };
};

// Layer Template
/* ╭──────╮ ╭─────────────┬─────────────┬─────────────┬─────────────┬─────────────╮ ╭──────╮ ╭─────────────┬─────────────┬─────────────┬─────────────┬─────────────╮ ╭──────╮ */
    // X_LN                                                                              X_MN                                                                             X_RN
/* ├──────┤ ├─────────────┼─────────────┼─────────────┼─────────────┼─────────────┤ ├──────┤ ├─────────────┼─────────────┼─────────────┼─────────────┼─────────────┤ ├──────┤ */
    // X_LT     X_MT    X_RT                                                         
/* ├──────┤ ├─────────────┼─────────────┼─────────────┼─────────────┼─────────────┤ ├──────┤ ├─────────────┼─────────────┼─────────────┼─────────────┼─────────────┤ ├──────┤ */
    // X_LM     X_MM    X_RM
/* ├──────┤ ├─────────────┼─────────────┼─────────────┼─────────────┼─────────────┤ ├──────┤ ├─────────────┼─────────────┼─────────────┼─────────────┼─────────────┤ ├──────┤ */
    // X_LB     X_MB    X_RB
/* ├──────┤ ╰─────────────┼─────────────┴─────────────┼─────────────┼─────────────┤ ├──────┤ ├─────────────┼─────────────┼─────────────┴───────────────────────────╯ ├──────┤ */
    // X_LH     X_MH    X_RH
/* ╰──────╯                                           ╰─────────────┴─────────────╯ ╰──────╯ ╰─────────────┴─────────────╯                                           ╰──────╯ */
